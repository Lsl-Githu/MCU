#ifndef _TFont_h
#define _TFont_h
/************************************************* 
 File name: TFont.h// 文件名
 Author: LiShuangLong  
 Version:V1.1 Date: 2023.4.20// 作者、版本及完成日期
 Description: tft显示相关程序// 用于详细说明此程序文件完成的主要功能，与其他模块
 Others: 无   // 其它内容的说明
 Function List: void Tft_Display();//根据接收数据显示函数  
 void Show_CH_Font16(int x,int y,int FontPos);//汉字选取函数
 // 主要函数列表，每条记录应包括函数名及功能简要说明
*************************************************/

#include <avr/pgmspace.h> 
#include <UTFT.h>
#include "wifi.h"
UTFT myGLCD(QD_TFT180A, A2, A1, A5, A4, A3);  //TFT引脚选择

//tft相关的字符库数组
extern uint8_t SmallFont[];
extern uint8_t BigFont[];
extern uint8_t SevenSegNumFont[];

//口味用于对比使用
const char *p1 = "微辣";
const char *p2 = "中辣";
const char *p3 = "特辣";


//tft汉字字库管理：逐列式，顺向 宋体 
const char tfont16[] PROGMEM =
{
0x00,0x00,0x02,0x02,0x42,0x22,0x22,0x22,0x1A,0x22,0x02,0x22,0x02,0x22,0xFE,0x22,
0x02,0x22,0x02,0x22,0x0A,0x22,0x12,0x22,0x63,0xFF,0x00,0x00,0x00,0x00,0x00,0x00,/*"当",0*/
0x10,0x00,0x10,0x00,0x17,0xFF,0x94,0x90,0x74,0x92,0x14,0x91,0x17,0xFE,0x10,0x00,
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0x08,0x40,0x08,0x40,0x08,0x40,0x08,0x40,0x08,0x40,0x00,0x40,0x00,0x40,0x00,0x00,/*"牛",37*/



};


//汉字选取扫描
void Show_CH_Font16(int x,int y,int FontPos)
{
  char temp, t, t1, k;
	int y0 = y;	
	int HZnum;

  //每个16*16的汉字点阵 有32个字节
  for (t = 0; t < 32; t++)
  {   
    temp = pgm_read_byte(&tfont16[t + 32*FontPos]);
                       
	  for (t1 = 0; t1 < 8; t1++)
	  {   
      if (temp&0x80)
      { 
        myGLCD.setColor(255,0, 0);//字体红色FontColor
        myGLCD.drawPixel(x,y);
      }
      else 
      { 
        myGLCD.setColor(255, 255, 255);//白色底BackColor
        myGLCD.drawPixel(x,y);
      }

      temp <<= 1;
      y++;

      if ((y - y0) == 16)
      {
        y = y0;
        x++;
        break;
      }
	     
	  }  	 
	}   
 
}


/*tft显示屏初始化*/
void Display_Init()
{
  randomSeed(analogRead(0));
  myGLCD.InitLCD();
  myGLCD.setFont(SmallFont);//*字符库
  
  /*myGLCD.clrScr();//清屏 
  myGLCD.fillScr(255, 255, 255);//全屏白色
  //显示字符串，x,y
  myGLCD.print("Color Test", CENTER, 30);
  //数字显示:12, x, y, len  
  //myGLCD.printNumI(12, 10, 50, 4);
  delay(1000);*/
  myGLCD.clrScr();//清屏 
  myGLCD.fillScr(255, 255, 255);//全屏白色
}

void hanzi_xz(int Num, int id, int wz)
{

  switch (id)
  {
    case 1:
    {
        Show_CH_Font16(0, wz, 9);//特色鱼头
        Show_CH_Font16(16, wz, 10);
        Show_CH_Font16(32, wz, 11);
        Show_CH_Font16(48, wz, 12);
        myGLCD.print(":", 64, wz+1); //显示字符串，x,y
        myGLCD.printNumI(Num, 72, wz+1, 1);//数字显示:12,x,y,len 
    }break;
    
    case 2:
    {
        Show_CH_Font16(0, wz, 13);//飞刀牛肉
        Show_CH_Font16(16, wz, 14);
        Show_CH_Font16(32, wz, 15);
        Show_CH_Font16(48, wz, 16);
        myGLCD.print(":", 64, wz+1); //显示字符串，x,y
        myGLCD.printNumI(Num, 72, wz+1, 1);//数字显示:12,x,y,len 
    }break;

    case 3:
    {
        Show_CH_Font16(0, wz, 17);//锅包肉
        Show_CH_Font16(16, wz, 18);
        Show_CH_Font16(32, wz, 16);
        myGLCD.print(":", 64, wz+1); //显示字符串，x,y
        myGLCD.printNumI(Num, 72, wz+1, 1);//数字显示:12,x,y,len 
    }break;

    case 4:
    {
        Show_CH_Font16(0, wz, 19);//八仙过海
        Show_CH_Font16(16, wz, 20);
        Show_CH_Font16(32, wz, 21);
        Show_CH_Font16(48, wz, 22);
        myGLCD.print(":", 64, wz+1); //显示字符串，x,y
        myGLCD.printNumI(Num, 72, wz+1, 1);//数字显示:12,x,y,len 
    }break;

    case 5:
    {
        Show_CH_Font16(0, wz, 23);//柿子鸡蛋
        Show_CH_Font16(16, wz, 24);
        Show_CH_Font16(32, wz, 25);
        Show_CH_Font16(48, wz, 26);
        myGLCD.print(":", 64, wz+1); //显示字符串，x,y
        myGLCD.printNumI(Num, 72, wz+1, 1);//数字显示:12,x,y,len 
    }break;
        
    case 6:
    {
        Show_CH_Font16(0, wz, 27);//拔丝紫薯
        Show_CH_Font16(16, wz, 28);
        Show_CH_Font16(32, wz, 29);
        Show_CH_Font16(48, wz, 30);
        myGLCD.print(":", 64, wz+1); //显示字符串，x,y
        myGLCD.printNumI(Num, 72, wz+1, 1);//数字显示:12,x,y,len         
    }break;
    
    case 7:
    {
        Show_CH_Font16(0, wz, 31);//腊八排骨
        Show_CH_Font16(16, wz, 32);
        Show_CH_Font16(32, wz, 33);
        Show_CH_Font16(48, wz, 34);
        myGLCD.print(":", 64, wz+1); //显示字符串，x,y
        myGLCD.printNumI(Num, 72, wz+1, 1);//数字显示:12,x,y,len         
    }break;
        
    case 8:
    {
        Show_CH_Font16(0, wz, 35);//上汤牛肉
        Show_CH_Font16(16, wz, 36);
        Show_CH_Font16(32, wz, 37);
        Show_CH_Font16(48, wz, 16);
        myGLCD.print(":", 64, wz+1); //显示字符串，x,y
        myGLCD.printNumI(Num, 72, wz+1, 1);//数字显示:12,x,y,len         
    }break;

  }

}

/*tft显示接收数据*/
void Tft_Display()
{
     
  static int wz = 16;
  //显示汉字：x,y,id
  Show_CH_Font16(32, 0, 0);
  Show_CH_Font16(48, 0, 1);
  Show_CH_Font16(64, 0, 2);
  Show_CH_Font16(80, 0, 3);
  char temp = 0;           
  if (xs_flag)
  {
    myGLCD.clrScr();//清屏 
    myGLCD.fillScr(255, 255, 255);//全屏白色
  /*for (char j = 0; j < 8; j++)
    {   
      if (REcv_Data[j].num > 0)
      {
        REcv_Data2[temp++] = REcv_Data[j];
        Serial.println(REcv_Data[j].num);
        Serial.println(REcv_Data[j].KWrr);
        Serial.println(REcv_Data[j].Id);
      }
      
    }*/

    wz = 16;
    for (char i = 0; i < 8; i++)
    {
      if(REcv_Data[i].num > 0)
      {
          hanzi_xz(REcv_Data[i].num,REcv_Data[i].Id, wz);
          if(REcv_Data[i].KWrr == p1     ) Show_CH_Font16(80, wz, 5);//微辣
          else if(REcv_Data[i].KWrr == p2) Show_CH_Font16(80, wz, 6);//中辣
          else if(REcv_Data[i].KWrr == p3) Show_CH_Font16(80, wz, 7);//特辣
          Show_CH_Font16(96, wz, 8);//辣
          wz += 16;
      }
        
    }

    for (char i = 0; i < 8; i++)
    { 

      REcv_Data[i].num = 0;
      REcv_Data[i].Id = 0;
      REcv_Data[i].KWrr = "";

    }
 
    xs_flag = 0;
    XS_fg = 1;
          
  }
      
}

#endif
